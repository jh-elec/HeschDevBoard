/* Generated by CodeDescriptor 1.5.0.0907 */
/*
* Project Name      -> Build Infos
* Version           -> 1.0.0.1231
* Author            -> Jan Homann @ Workstadion.: XXXJANIIIX3XXX
* Build Date        -> 31.12.2017 11:19:49
* Description       -> Building infos from Preprocessor
*
*
*
*/

#include <avr/io.h>

#include "version_num.h"
#include "build_info.h"


char *buildVer(void)
{
	static char build[] = "000000000000000000000000";
	
	/*
	*	major and minor version
	*/
	build[0] = verMajor;
	build[1] = '.';
	build[2] = ' ';
	build[3] = verMinor;
	build[4] = '.';
	build[5] = ' ';
	
	/*
	*	Fehlerkorrekturen
	*/
	build[6] = ( ( FEHLERKORREKTUR / 10000 )	% 10 )	+ '0';
	build[7] = ( ( FEHLERKORREKTUR / 1000 )		% 10 )	+ '0';
	build[8] = ( ( FEHLERKORREKTUR / 100 )		% 10 )	+ '0';
	build[9] = ( ( FEHLERKORREKTUR / 10 )		% 10 )	+ '0';
	build[10] = (   FEHLERKORREKTUR % 10 )				+ '0';
	build[11] = '.';
	build[12] = ' ';
	
	/*
	*	time.: hour|min
	*/
	build[13] = __TIME__[0];
	build[14] = __TIME__[1];
	build[15] = __TIME__[3];
	build[16] = __TIME__[4];
	
	build[17] = '.';
	build[18] = ' ';
	
	/*
	*	day
	*/
	build[19] = ((__DATE__[4] >= '0') ? (__DATE__[4]) : '0');
	build[20] = (__DATE__[ 5]);
	
	/*
	*	month
	*/
	if(__DATE__[0] == 'J' && __DATE__[1] == 'a')
	build[21] = '1'; // Januar

	if(__DATE__[0] == 'F')
	build[21] = '2'; // Februar
	
	if(__DATE__[0] == 'M' && __DATE__[1] == 'a' && __DATE__[2] == 'r')
	build[21] = '3'; // März
	
	if(__DATE__[0] == 'A' && __DATE__[1] == 'p')
	build[21] = '4'; // April
	
	if(__DATE__[0] == 'M' && __DATE__[1] == 'a' && __DATE__[2] == 'y')
	build[21] = '5'; // Mai
	
	if(__DATE__[0] == 'J' && __DATE__[1] == 'u' && __DATE__[2] == 'n')
	build[21] = '6'; // Juni
	
	if(__DATE__[0] == 'J' && __DATE__[1] == 'u' && __DATE__[2] == 'l')
	build[21] = '7'; // Juli
	
	if(__DATE__[0] == 'A' && __DATE__[1] == 'u')
	build[21] = '8'; // August
	
	if(__DATE__[0] == 'S')
	build[21] = '9'; // September

	if(__DATE__[0] == 'O'){
		build[21] = '1';
		build[22] = '0'; // Oktober
	}

	if(__DATE__[0] == 'N'){
		build[21] = '1';
		build[22] = '1'; // November
	}
	
	if(__DATE__[0] == 'D'){
		build[21] = '1';
		build[22] = '2'; // Dezember
	}

	build[23] = '\0';
	
	return build;
}
