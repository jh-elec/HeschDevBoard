/* Generated by CodeDescriptor 1.5.0.0907 */
/*
* Project Name      -> stringHandler
* Version           -> 1.0.0.0920
* Author            -> Hm @ Workstadion.: QP-01-02
* Build Date        -> 20.09.2017 07:50:01
* Description       -> Description
*
*
*
*/

#include <avr/io.h>
#include <string.h>

#include "stringHandler.h"

cmd_t cmd =
{
	.allow =	{
		"-gettime",
		"-settime",
		"-getdate",
		"-setdate",
		"-info",
		"-booty",
		"-reset",	// 6
		
		"-k1_set",
		"-k1_unset",			// 8

		"-k2_set",
		"-k2_unset",			// 10

		"-k3_set",
		"-k3_unset",			// 12

		"-k4_set",
		"-k4_unset",			// 14

		"-k5_set",
		"-k5_unset",			// 16

		"-k6_set",
		"-k6_unset",			// 18

		"-k7_set",
		"-k7_unset",			// 20

		"-k8_set",
		"-k8_unset",			// 22

		"-get_state",			// 23
		"-unset_all",			
		"-set_all",	
		"-digit1_",
		"-digit2_",
		"-digit3_",
		"-digit4_",

	}
};

string_t str =
{
	.Search		= searchCmd,
	.Compare	= compareString,
	.Count		= countString,
};

char searchCmd(char cmdBuff[], cmd_t *cmds)
{
	unsigned char cntCmd = 0x00;
	
	for(cntCmd = 0x00 ; cntCmd < (sizeof(cmds->allow) / sizeof(cmds->allow[0])) ; cntCmd++)
	{
		if(strstr(cmdBuff, cmds->allow[cntCmd]) != NULL)
		{
			return cntCmd;
		}
	}
	return -1;
}

uint8_t compareString(char *strOne, char *strTwo)
{	
	uint8_t identicalChar = 0x00;
		
	while(*strOne)
	{
		if(*strOne++ != *strTwo++)
		{
			return 1;
			break;
		}
		identicalChar++;
	}
	return identicalChar;
}

uint8_t countString(char *str)
{
	uint8_t charCnt = 0x00;
	while(*str)
	{
		charCnt++;
	}
	return charCnt;
}